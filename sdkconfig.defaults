## sdkconfig.defaults
```kconfig
# Use this to set FreeRTOS kernel tick frequency to 1000 Hz (100 Hz by default).
# This allows to use 1 ms granuality for thread sleeps (10 ms by default).
#CONFIG_FREERTOS_HZ=1000

# Workaround for https://github.com/espressif/esp-idf/issues/7631
#CONFIG_MBEDTLS_CERTIFICATE_BUNDLE=n
#CONFIG_MBEDTLS_CERTIFICATE_BUNDLE_DEFAULT_FULL=n

# Async rust really needs some extra stack size
CONFIG_ESP_MAIN_TASK_STACK_SIZE=18000

# lwIP stack size
CONFIG_LWIP_TCPIP_TASK_STACK_SIZE=8192

# pthread default stack size
CONFIG_PTHREAD_TASK_STACK_SIZE_DEFAULT=8192

# event stack size
CONFIG_ESP_SYSTEM_EVENT_TASK_STACK_SIZE=4096
```
